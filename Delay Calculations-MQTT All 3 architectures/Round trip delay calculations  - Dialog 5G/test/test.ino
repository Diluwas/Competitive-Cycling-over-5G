#include <WiFi.h>
#include <PubSubClient.h>

//const char *ssid     = "Dialog 4G 075";
//const char *password = "al123456";
//const char* mqtt_server = "test.mosquitto.org";


//const char *ssid     = "V2061";        //my hotspot
//const char *password = "Dulsara123";

//const char *ssid     = "Aruna-Lakpriya";      //4G core
//const char *password = "al123456";

//const char *ssid     = "Dialog 4G 075";       //Aruna 4G
//const char *password = "al123456";

//const char *ssid     = "Dialog 4G TNR";         //Tharuka 4G
//const char *password = "Legendseeker#23";

//const char *ssid     = "5G PSI router";         //Dialog 5G
//const char *password = "Dialog@psi25689";

const char *ssid     = "HUAWEI_H112_239E";         //Uni 5G
const char *password = "houseoffire";

//const char* mqtt_server = "192.168.1.10";
//const char* mqtt_server = "192.168.8.183";
const char* mqtt_server = "test.mosquitto.org";


const char* send_topic = "VRcycling/UserA/Speed";   //esp32 speed send topic
const char* recieved_topic = "VRcycling/test2";    //Oculus end speed publish topic
//const char* send_topic = "VRcycling/UserA/Distance";   //esp32 distance send topic
//const char* recieved_topic = "VRcycling/test2";    //Oculus end distance publish topic
char sendMessage[10];
int num = 0;
bool recieved = true;

float mydata[1441] = {0.0, 0.08, 0.09, 0.11, 0.15, 0.2, 0.22, 0.23, 0.24, 0.26, 0.27, 0.28, 0.3, 0.32, 0.34, 0.36, 0.4, 0.52, 0.55, 0.94, 1.46, 1.82, 1.91, 1.93, 2.01, 
2.36, 2.54, 2.82, 2.94, 3.06, 3.14, 3.17, 3.47, 3.43, 3.61, 3.91, 4.03, 4.11, 4.23, 4.22, 4.12, 4.13, 4.32, 4.29, 4.22, 4.35, 4.48, 4.42, 4.35, 4.38, 4.45, 4.36, 
4.5, 4.67, 4.6, 4.59, 4.66, 4.59, 4.54, 4.81, 4.85, 4.77, 4.76, 4.84, 4.76, 4.7, 4.8, 4.77, 4.72, 4.75, 4.86, 4.79, 4.76, 4.95, 4.91, 4.85, 4.88, 4.9, 4.83, 4.91, 
5.02, 4.95, 4.87, 4.98, 4.94, 5.09, 5.19, 5.14, 5.15, 5.18, 5.12, 5.13, 5.26, 5.28, 5.31, 5.26, 5.29, 5.24, 5.28, 5.22, 5.21, 5.32, 5.28, 5.26, 5.31, 5.25, 5.22, 
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0.75, 0.39, 0.09, 0.0, 0.07, 0.08, 0.09, 0.1, 0.09};


WiFiClient wifiClient;
PubSubClient client(wifiClient);

void setupWiFi() {
  delay(10);
  Serial.println();
  Serial.print("Connecting to ");
  Serial.println(ssid);

  WiFi.begin(ssid, password);
  while (WiFi.status() != WL_CONNECTED) {
    delay(500);
    Serial.print(".");
  }
  randomSeed(micros());
  Serial.println("");
  Serial.println("WiFi connected");
  Serial.println("IP address: ");
  Serial.println(WiFi.localIP());
}


void callback(char* topic, byte* payload, unsigned int length) {
  Serial.print("Payload: ");
  for (int i = 0; i < length; i++) {
    Serial.print((char)payload[i]);
  }
  Serial.println();
  recieved = true;
}


void reconnect() {
  while (!client.connected()) {
    Serial.print("Attempting MQTT connection...");
    // Create a random client ID
    String clientId = "ESP8266Client-";
    clientId += String(random(0xffff), HEX);
    // Attempt to connect
    if (client.connect(clientId.c_str())) {
      Serial.println("connected");
      // Once connected, publish an announcement...
      //client.publish("outgoingTopic", "hello world");
      // ... and resubscribe
      client.subscribe(recieved_topic);
    } else {
      Serial.print("failed, rc=");
      Serial.print(client.state());
      Serial.println(" try again in 5 seconds");
      // Wait 5 seconds before retrying
      delay(5000);
    }
  }
}

void setup() {
  Serial.begin(115200);
  setupWiFi();
  client.setServer(mqtt_server, 1883);
  client.setCallback(callback);
}


void loop() {
  if (!client.connected()) {
    reconnect();
    Serial.print("connected");
  }
  client.loop();
  if(num < 1441){
    if(recieved == true){
      dtostrf(mydata[num],4,2,sendMessage);
      Serial.println(sendMessage);
      client.publish(send_topic, sendMessage);
      recieved = false;
      num++;
    }
  }
}

